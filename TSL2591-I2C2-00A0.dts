/dts-v1/;
/plugin/;

/ {
  compatible = "ti,beaglebone", "ti,beaglebone-black";
  part-number = "TSL2591-I2C2";
  version = "00A0";

  fragment@0 {
    target = <&i2c2>;

    __overlay__ {
      tsl2591: tsl2591@29 {
          compatible = "amstaos,tsl2591";
          #address-cells = <1>;
          #size-cells = <0>;
          reg = <0x29>;

	  interrupt-parent = <&gpio0>;
          interrupts = <20 2>;

          als-integration-time = <0x03>;
          als-gain = <0x10>;
          als-persist = <0x04>;
          als-lower-threshold = <100>;
          als-upper-threshold = <1000>;
      };
    };
  };
};
